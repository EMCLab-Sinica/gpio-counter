/**
 * @cliArgs --board "/ti/boards/CC1352R1_LAUNCHXL" --rtos "nortos" --product "simplelink_cc13xx_cc26xx_sdk@5.30.01.01"
 * @versions {"tool":"1.10.0+2163"}
 */

/**
 * Import the modules used in this configuration.
 */
const GPIO   = scripting.addModule("/ti/drivers/GPIO");
const GPIO1  = GPIO.addInstance();
const GPIO2  = GPIO.addInstance();
const GPIO3  = GPIO.addInstance();
const GPIO6  = GPIO.addInstance();
const GPIO7  = GPIO.addInstance();
const RTOS   = scripting.addModule("/ti/drivers/RTOS");
const Timer  = scripting.addModule("/ti/drivers/Timer", {}, false);
const Timer1 = Timer.addInstance();
const UART2  = scripting.addModule("/ti/drivers/UART2", {}, false);
const UART21 = UART2.addInstance();

/**
 * Write custom configuration values to the imported modules.
 */
GPIO1.$name           = "CONFIG_GPIO_INPUT_INFERENCE";
GPIO1.pull            = "Pull Down";
GPIO1.gpioPin.$assign = "boosterpack.31";

GPIO2.$name           = "CONFIG_GPIO_INPUT_POWER";
GPIO2.pull            = "Pull Down";
GPIO2.gpioPin.$assign = "boosterpack.18";

GPIO3.pull            = "Pull Down";
GPIO3.$name           = "CONFIG_GPIO_INPUT_INDICATOR0";
GPIO3.gpioPin.$assign = "boosterpack.37";

GPIO6.$name           = "CONFIG_GPIO_INPUT_INDICATOR1";
GPIO6.pull            = "Pull Down";
GPIO6.gpioPin.$assign = "boosterpack.36";

GPIO7.$name           = "CONFIG_GPIO_INPUT_INDICATOR2";
GPIO7.pull            = "Pull Down";
GPIO7.gpioPin.$assign = "boosterpack.9";

Timer1.$name               = "CONFIG_TIMER_0";
Timer1.timerType           = "32 Bits";
Timer1.timerInstance.$name = "CONFIG_GPTIMER_0";

const CCFG              = scripting.addModule("/ti/devices/CCFG", {}, false);
CCFG.ccfgTemplate.$name = "ti_devices_CCFGTemplate0";

UART21.$name               = "CONFIG_UART2_0";
UART21.$hardware           = system.deviceData.board.components.XDS110UART;
UART21.txPinInstance.$name = "CONFIG_PIN_1";
UART21.rxPinInstance.$name = "CONFIG_PIN_3";

/**
 * Pinmux solution for unlocked pins/peripherals. This ensures that minor changes to the automatic solver in a future
 * version of the tool will not impact the pinmux you originally saw.  These lines can be completely deleted in order to
 * re-solve from scratch.
 */
Timer1.timerInstance.timer.$suggestSolution = "GPTM0";
UART21.uart.$suggestSolution                = "UART0";
UART21.uart.txPin.$suggestSolution          = "boosterpack.4";
UART21.uart.rxPin.$suggestSolution          = "boosterpack.3";
